## helloworld/conf/bblayers.conf
```bitbake
LAYERSERIES_CORENAMES = "rocko"

BBLAYERS ?= " \
    /home/work/github/bitbake_example_test/helloworld/ \
"
```

## helloworld/core/conf/bblayers.conf
```bitbake
LAYERSERIES_CORENAMES = "aabbcc"

BBLAYERS ?= " \
    /home/work/github/bitbake_example_test/helloworld/core \
    /home/work/github/bitbake_example_test/helloworld/mylayer \
"
```

## helloworld/core/conf/layer.conf
```bitbake
BBPATH .= ":${LAYERDIR}"
BBFILES += "${LAYERDIR}/*.bb"
BBFILE_COLLECTIONS += "helloworld"
BBFILE_PATTERN_fakelayer := "^${LAYERDIR}/"

BBFILE_PATTERN_helloworld := "^${LAYERDIR}/" 
LAYERSERIES_COMPAT_helloworld = "aabbcc"
```
